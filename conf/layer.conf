## conf/layer.conf
```bitbake
# We have a conf and classes directory, add to BBPATH
BBPATH .= ":${LAYERDIR}"

# We have recipes-* directories, add to BBFILES
BBFILES += " \
	${LAYERDIR}/recipes-*/*/*.bb \
	${LAYERDIR}/recipes-*/*/*.bbappend \
	"

BBFILE_COLLECTIONS += "meta-mistra-apps"
BBFILE_PATTERN_meta-mistra-apps = "^${LAYERDIR}/"
LAYERDEPENDS_meta-mistra-apps = " \
	meta-mistra-base \
	core \
"

LAYERSERIES_COMPAT_meta-mistra-apps = "kirkstone"
```
